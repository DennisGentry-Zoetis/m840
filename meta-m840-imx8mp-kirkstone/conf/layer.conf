## meta-m840-imx8mp-kirkstone/conf/layer.conf
```bitbake
# We have a conf and classes directory, add to BBPATH
BBPATH .= ":${LAYERDIR}"

# We have recipes-* directories, add to BBFILES
BBFILES += "${LAYERDIR}/recipes-*/*/*.bb \
            ${LAYERDIR}/recipes-*/*/*.bbappend"

BBFILE_COLLECTIONS += "m840-bsp-layer"
BBFILE_PATTERN_m840-bsp-layer = "^${LAYERDIR}/"
BBFILE_PRIORITY_m840-bsp-layer = "10"

LAYERDEPENDS_m840-bsp-layer = "core"
LAYERSERIES_COMPAT_m840-bsp-layer = "kirkstone hardknott zeus"

BBLAYERS_LAYERINDEX_NAME_m840-bsp-layer = "m840-imx8mp"
```
